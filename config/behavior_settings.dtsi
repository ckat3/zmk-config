// SETTINGS
#define _STICKY_TIMEOUT      2000

#define _MACRO_TAP_PADDING   1    // delay between key presses
#define _MACRO_TAP_FOR       1    // how long to hold tapped key_MACRO_TAP_FOR_SLOW

#define _COMBO_TIMEOUT       16   // (18 is good, 15 might be too little) maximum interval between keys to form combo
#define _COMBO_TIMEOUT_SLOW  32

// how long must hold to not be tap
#define _HT_TAPLIMIT_SLOW    280  
#define _HT_TAPLIMIT         200  // (240 is good)
#define _HT_TAPLIMIT_FAST    190  // 
#define _HT_TAPLIMIT_FASTER  110  // 

#define _HT_QUICKTAP        150  // how fast must press twice for second to start repeating tap (200 is upper limit)

&sk { // one-shot modifier
	release-after-ms = < _STICKY_TIMEOUT >;
	quick-release;
};

&sl { // one-shot layer
	release-after-ms = < _STICKY_TIMEOUT >;
	quick-release;
};

&mt { // hold-tap
	tapping-term-ms = < _HT_TAPLIMIT_FASTER >;
	quick-tap-ms    = < _HT_QUICKTAP >;
};

&lt { // hold layer, tap kp
	flavor          = "tap-preferred"; //"balanced"; // (which one is better?)
	tapping-term-ms = < _HT_TAPLIMIT >;
	quick-tap-ms    = < _HT_QUICKTAP >;
};