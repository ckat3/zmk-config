// SETTINGS
#define _STICKY_TIMEOUT      2000

#define _MACRO_TAP_PADDING   1    // delay between automatic key taps in a macro
#define _MACRO_TAP_FOR       1    // how long to hold tapped key

#define _COMBO_TIMEOUT       17   // (16 might be too little) maximum interval between keys to form combo
#define _COMBO_TIMEOUT_SLOW  32   // for harder combos (notably OE)

// how long must hold to not be tap
#define _HT_TAP_THRESHOLD_SLOW    280  
#define _HT_TAP_THRESHOLD         235  // (200 is too low)
#define _HT_TAP_THRESHOLD_FAST    190  // 
#define _HT_TAP_THRESHOLD_FASTER  110  // 

// how long must have passed since the last key to count as a hold
#define _HT_PRIOR_IDLE 150

// how fast must press twice for second to start repeating tap
#define _HT_QUICKTAP 150 

&sk { // one-shot modifier
	release-after-ms = < _STICKY_TIMEOUT >;
	quick-release;
};

&sl { // one-shot layer
	release-after-ms = < _STICKY_TIMEOUT >;
	quick-release;
};

&mt { // hold-tap
	tapping-term-ms = < _HT_TAP_THRESHOLD_FASTER >;
	quick-tap-ms    = < _HT_QUICKTAP >;
};

&lt { // hold layer, tap kp
	flavor          = "tap-preferred"; //"balanced"; // (which one is better?)
	tapping-term-ms = < _HT_TAP_THRESHOLD >;
	quick-tap-ms    = < _HT_QUICKTAP >;
};